## examples/gy912/Kconfig
```kconfig
#
# For a description of the syntax of this configuration file,
# see the file kconfig-language.txt in the NuttX tools repository.
#

config EXAMPLES_GY912
	tristate "GY-912 Sensor Example"
	default n
	depends on RA_SPI && SENSORS
	---help---
		Enable the GY-912 sensor example application.
		This demonstrates SPI communication with ICM20948 and BMP388 sensors.

if EXAMPLES_GY912

config EXAMPLES_GY912_PROGNAME
	string "Program name"
	default "gy912_test"
	---help---
		This is the name of the program that will be used when the NSH ELF
		program is installed.

config EXAMPLES_GY912_PRIORITY
	int "GY-912 task priority"
	default 100

config EXAMPLES_GY912_STACKSIZE
	int "GY-912 stack size"
	default 4096

endif
```

## examples/rzv_dmac/Kconfig
```kconfig
#
# For a description of the syntax of this configuration file,
# see the file kconfig-language.txt in the NuttX tools repository.
#

config EXAMPLES_RZV_DMAC
	tristate "RZV2H DMAC test application"
	default n
	depends on RZV_DMAC
	---help---
		Enable the RZ/V2H CR8-0 DMAC polling memory-copy test. It uses
		channel 0 with one aligned 1 KiB, 4-byte incrementing transfer.
		Hardware triggers, callbacks, and peripheral transfers are not
		part of this example.

if EXAMPLES_RZV_DMAC

config EXAMPLES_RZV_DMAC_PROGNAME
	string "Program name"
	default "rzv_dmac"
	---help---
		This is the name of the program that will be used when the NSH ELF
		program is installed.

config EXAMPLES_RZV_DMAC_PRIORITY
	int "RZV DMAC test task priority"
	default 100

config EXAMPLES_RZV_DMAC_STACKSIZE
	int "RZV DMAC test stack size"
	default DEFAULT_TASK_STACKSIZE

endif
```

## examples/rzv_ipc_demo/Kconfig
```kconfig
#
# For a description of the syntax of this configuration file,
# see the file kconfig-language.txt in the NuttX tools repository.
#

config EXAMPLES_RZV_IPC_DEMO
	tristate "RZ/V2H IPC ping/echo demo (ipctest)"
	default n
	depends on IPCC
	---help---
		Enable the RZ/V2H IPC ping/echo demo application.

		Provides an 'ipctest' command that exercises any /dev/ipccN device:

		  --ping  -d <dev> -n <count> [-s <size>] [--timeout <ms>]
		     Send N fixed-size messages, expect echo from peer, print stats.

		  --echo  -d <dev>
		     Loop: read one message, write it back. Runs on the peer core.

		Works with both rptun-backed /dev/ipcc0 and raw-ring /dev/ipcc1,2.

if EXAMPLES_RZV_IPC_DEMO

config EXAMPLES_RZV_IPC_DEMO_PROGNAME
	string "Program name"
	default "ipctest"
	---help---
		Name of the installed NSH builtin command.

config EXAMPLES_RZV_IPC_DEMO_PRIORITY
	int "Task priority"
	default 100

config EXAMPLES_RZV_IPC_DEMO_STACKSIZE
	int "Stack size"
	default DEFAULT_TASK_STACKSIZE

endif
```

## testing/rzv_hwtest/Kconfig
```kconfig
#
# RZ/V2H hardware test app
#

config TESTING_RZV_HWTEST
	tristate "RZ/V2H hardware test (RTT-based CI)"
	default n
	---help---
		On-target test harness for UART/SPI/SCI-I2C drivers.
		Emits structured PASS/FAIL lines over SEGGER RTT for off-target
		JUnit conversion. See plans/260516-1051-ci-rtt/.

if TESTING_RZV_HWTEST

config TESTING_RZV_HWTEST_PROGNAME
	string "Program name"
	default "hwtest"

config TESTING_RZV_HWTEST_PRIORITY
	int "Task priority"
	default 100

config TESTING_RZV_HWTEST_STACKSIZE
	int "Stack size"
	default 8192

choice
	prompt "Test mode (selects which suites to run)"
	default TESTING_RZV_HWTEST_MODE_UART_LOOPBACK

config TESTING_RZV_HWTEST_MODE_UART_LOOPBACK
	bool "UART loopback (TX<->RX jumpers)"

config TESTING_RZV_HWTEST_MODE_SPI_LOOPBACK
	bool "SPI loopback (MOSI<->MISO jumper)"

config TESTING_RZV_HWTEST_MODE_HIL_FULL
	bool "HIL full (real drone sensors per RDK-RZ/V2H pinout)"

endchoice

endif
```
